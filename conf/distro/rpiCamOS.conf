## conf/distro/rpiCamOS.conf
```bitbake
DISTRO_NAME = "Raspberry PI CamOs"
DISTRO_VERSION = "0.1"

DISTRO_FEATURES ?= "${DISTRO_FEATURES_DEFAULT}  "
```

## conf/layer.conf
```bitbake
# We have a conf and classes directory, add to BBPATH
BBPATH .= ":${LAYERDIR}"

# We have recipes-* directories, add to BBFILES
BBFILES += "${LAYERDIR}/recipes-*/*/*.bb \
            ${LAYERDIR}/recipes-*/*/*.bbappend"

BBFILE_COLLECTIONS += "meta-rpi-cam-web-interface"
BBFILE_PATTERN_meta-rpi-cam-web-interface = "^${LAYERDIR}/"
BBFILE_PRIORITY_meta-rpi-cam-web-interface = "6"

LAYERDEPENDS_meta-rpi-cam-web-interface = "core"
LAYERSERIES_COMPAT_meta-rpi-cam-web-interface = "warrior zeus"
```
